## config/boards/shields/faw36/Kconfig.defconfig
```kconfig
# Copyright (c) 2020 The ZMK Contributors
# SPDX-License-Identifier: MIT

config ZMK_BLE
	default y

config BT_MAX_CONN
	default 1

config BT_MAX_PAIRED
	default 1

config ZMK_USB
	default y

if SHIELD_FAW36_LEFT

config ZMK_KEYBOARD_NAME
	default "faw36"

config ZMK_SPLIT_ROLE_CENTRAL
	default y

endif

if SHIELD_FAW36_LEFT || SHIELD_FAW36_RIGHT

config ZMK_SPLIT
	default y

endif
```
